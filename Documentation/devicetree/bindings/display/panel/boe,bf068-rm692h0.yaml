## Documentation/devicetree/bindings/phy/qcom,sm8650-csi2-phy.yaml
```yaml
# SPDX-License-Identifier: (GPL-2.0 OR BSD-2-Clause)
# Copyright (c) 2026 Linaro Ltd.
%YAML 1.2
---
$id: http://devicetree.org/schemas/phy/qcom,sm8650-csi2-phy.yaml#
$schema: http://devicetree.org/meta-schemas/core.yaml#

title: Qualcomm SM8650 CSI2 PHY

maintainers:
  - Cosmin Tanislav <demonsingur@gmail.com>

description:
  Qualcomm MIPI CSI2 D-PHY / C-PHY. Connects MIPI CSI2 sensors to Qualcomm's
  Camera CSI Decoder on the SM8650 SoC.

properties:
  compatible:
    enum:
      - qcom,sm8650-csi2-phy

  reg:
    maxItems: 1

  clocks:
    maxItems: 3

  clock-names:
    items:
      - const: core
      - const: timer
      - const: csiphy_rx

  interrupts:
    maxItems: 1

  operating-points-v2: true

  opp-table:
    type: object

  power-domains:
    items:
      - description: Titan Top GDSC - Titan ISP Block, Global Distributed Switch Controller.

  power-domain-names:
    items:
      - const: top

  vdda-phy-supply:
    description: Phandle to PHY supply.

  vdda-pll-supply:
    description: Phandle to PLL supply.

  qcom,channel-type:
    $ref: /schemas/types.yaml#/definitions/uint32
    enum: [ 0, 1 ]
    default: 0
    description:
      C-PHY data rate channel calibration variant the connected module
      requires, 0 for the short channel and 1 for the standard channel rate
      table entries.

  ports:
    $ref: /schemas/graph.yaml#/properties/ports

    properties:
      port@0:
        $ref: /schemas/graph.yaml#/$defs/port-base
        description:
          Sensor input. A single sensor is described by a single endpoint
          with one to four data lanes, numbered 1-4. The clock lane is
          position 0.

        unevaluatedProperties: false

        patternProperties:
          "^endpoint(@0)?$":
            $ref: /schemas/media/video-interfaces.yaml#
            unevaluatedProperties: false
            properties:
              bus-type:
                enum:
                  - 1 # MEDIA_BUS_TYPE_CSI2_CPHY
                  - 4 # MEDIA_BUS_TYPE_CSI2_DPHY
                default: 4

              data-lanes:
                minItems: 1
                maxItems: 4
                items:
                  minimum: 1
                  maximum: 4
                description:
                  Data lane positions following this endpoint's clock
                  lane. Positions are a per-port logical numbering, not
                  package pad or ball positions.

            required:
              - data-lanes
              - remote-endpoint

      port@1:
        $ref: /schemas/graph.yaml#/properties/port
        description: Output to the CAMSS CSIPHY controller.

    required:
      - port@0
      - port@1

required:
  - compatible
  - reg
  - clocks
  - clock-names
  - interrupts
  - operating-points-v2
  - power-domains
  - power-domain-names
  - vdda-phy-supply
  - vdda-pll-supply
  - ports

additionalProperties: false

examples:
  - |
    #include <dt-bindings/clock/qcom,sm8650-camcc.h>
    #include <dt-bindings/interrupt-controller/arm-gic.h>
    #include <dt-bindings/media/video-interfaces.h>

    csiphy0: phy@ace4000 {
        compatible = "qcom,sm8650-csi2-phy";
        reg = <0x0ace4000 0x2000>;

        clocks = <&camcc CAM_CC_CSIPHY0_CLK>,
                 <&camcc CAM_CC_CSI0PHYTIMER_CLK>,
                 <&camcc CAM_CC_CSID_CSIPHY_RX_CLK>;
        clock-names = "core",
                      "timer",
                      "csiphy_rx";

        interrupts = <GIC_SPI 477 IRQ_TYPE_EDGE_RISING>;

        operating-points-v2 = <&csiphy_opp_table>;

        power-domains = <&camcc CAM_CC_TITAN_TOP_GDSC>;
        power-domain-names = "top";

        vdda-phy-supply = <&vreg_l2i_0p88>;
        vdda-pll-supply = <&vreg_l3i_1p2>;

        ports {
            #address-cells = <1>;
            #size-cells = <0>;

            port@0 {
                reg = <0>;
                csiphy0_in: endpoint {
                    bus-type = <MEDIA_BUS_TYPE_CSI2_CPHY>;
                    data-lanes = <1 2 3>;
                    remote-endpoint = <&sensor_out>;
                };
            };

            port@1 {
                reg = <1>;
                csiphy0_out: endpoint {
                    remote-endpoint = <&camss_ep0>;
                };
            };
        };
    };

    csiphy_opp_table: opp-table-csiphy {
        compatible = "operating-points-v2";

        opp-400000000 {
            opp-hz = /bits/ 64 <400000000>;
        };

        opp-480000000 {
            opp-hz = /bits/ 64 <480000000>;
        };
    };
...
```

## Documentation/devicetree/bindings/soc/qcom/qcom,ipclite.yaml
```yaml
# SPDX-License-Identifier: (GPL-2.0-only OR BSD-2-Clause)
%YAML 1.2
---
$id: http://devicetree.org/schemas/soc/qcom/qcom,ipclite.yaml#
$schema: http://devicetree.org/meta-schemas/core.yaml#

title: Qualcomm IPCLite shared memory protocol

maintainers:
  - Cosmin Tanislav <demonsingur@gmail.com>

description:
  IPCLite is a shared memory protocol that the application processor, the
  compute DSP, the camera ICP and the EVA processor use to exchange hardware
  fence messages and global fence state. The application processor lays out
  the shared memory, signals every other core through the compute IPCC that
  it is ready, and then exchanges 64-bit messages with each core through a
  FIFO pair in the shared memory and an IPCC signal per direction.

properties:
  compatible:
    const: qcom,sm8650-ipclite

  memory-region:
    maxItems: 1
    description: The IPCLite shared memory.

  hwlocks:
    maxItems: 1
    description:
      The IPCLite hardware mutex, released when the core holding it crashes.

  mboxes:
    items:
      - description: Broadcast mem-init signal
      - description: Message signal to the application processor
      - description: Message signal to the compute DSP
      - description: Message signal to the EVA processor
      - description: Message signal to the camera ICP
      - description: Recovery signal to the compute DSP
      - description: Recovery signal to the EVA processor
      - description: Recovery signal to the camera ICP

  mbox-names:
    items:
      - const: mem-init
      - const: apss
      - const: cdsp
      - const: cvp
      - const: cam
      - const: cdsp-ssr
      - const: cvp-ssr
      - const: cam-ssr

  interrupts:
    items:
      - description: Messages from the application processor
      - description: Messages from the compute DSP
      - description: Messages from the EVA processor
      - description: Messages from the camera ICP

  interrupt-names:
    items:
      - const: apss
      - const: cdsp
      - const: cvp
      - const: cam

required:
  - compatible
  - memory-region
  - hwlocks
  - mboxes
  - mbox-names
  - interrupts
  - interrupt-names

additionalProperties: false

examples:
  - |
    #include <dt-bindings/interrupt-controller/irq.h>
    #include <dt-bindings/mailbox/qcom-ipcc.h>

    ipclite {
        compatible = "qcom,sm8650-ipclite";
        memory-region = <&global_sync_mem>;
        hwlocks = <&tcsr_mutex 11>;

        mboxes = <&ipcc_compute IPCC_CLIENT_BROADCAST IPCC_COMPUTE_L0_SIGNAL_IPCLITE_MEM_INIT>,
                 <&ipcc_compute IPCC_CLIENT_APSS IPCC_COMPUTE_L0_SIGNAL_IPCLITE_MSG>,
                 <&ipcc_compute IPCC_CLIENT_CDSP IPCC_COMPUTE_L0_SIGNAL_IPCLITE_MSG>,
                 <&ipcc_compute IPCC_CLIENT_CVP IPCC_COMPUTE_L0_SIGNAL_IPCLITE_MSG>,
                 <&ipcc_compute IPCC_CLIENT_CAM IPCC_COMPUTE_L0_SIGNAL_IPCLITE_MSG>,
                 <&ipcc_compute IPCC_CLIENT_CDSP IPCC_COMPUTE_L0_SIGNAL_IPCLITE_SSR>,
                 <&ipcc_compute IPCC_CLIENT_CVP IPCC_COMPUTE_L0_SIGNAL_IPCLITE_SSR>,
                 <&ipcc_compute IPCC_CLIENT_CAM IPCC_COMPUTE_L0_SIGNAL_IPCLITE_SSR>;
        mbox-names = "mem-init", "apss", "cdsp", "cvp", "cam",
                     "cdsp-ssr", "cvp-ssr", "cam-ssr";

        interrupts-extended = <&ipcc_compute IPCC_CLIENT_APSS IPCC_COMPUTE_L0_SIGNAL_IPCLITE_MSG
                               IRQ_TYPE_EDGE_RISING>,
                              <&ipcc_compute IPCC_CLIENT_CDSP IPCC_COMPUTE_L0_SIGNAL_IPCLITE_MSG
                               IRQ_TYPE_EDGE_RISING>,
                              <&ipcc_compute IPCC_CLIENT_CVP IPCC_COMPUTE_L0_SIGNAL_IPCLITE_MSG
                               IRQ_TYPE_EDGE_RISING>,
                              <&ipcc_compute IPCC_CLIENT_CAM IPCC_COMPUTE_L0_SIGNAL_IPCLITE_MSG
                               IRQ_TYPE_EDGE_RISING>;
        interrupt-names = "apss", "cdsp", "cvp", "cam";
    };
```

## Documentation/devicetree/bindings/sound/qcom,wcn-btfm-slim.yaml
```yaml
# SPDX-License-Identifier: (GPL-2.0-only OR BSD-2-Clause)
%YAML 1.2
---
$id: http://devicetree.org/schemas/sound/qcom,wcn-btfm-slim.yaml#
$schema: http://devicetree.org/meta-schemas/core.yaml#

title: Qualcomm WCN Bluetooth SLIMbus audio interface

maintainers:
  - Cosmin Tanislav <demonsingur@gmail.com>

description:
  The Bluetooth part of Qualcomm WCN chips such as the WCN7850 exchanges SCO
  and offloaded A2DP audio with the audio DSP over SLIMbus. It enumerates as a
  ported generic device with the data ports and an interface device with the
  port configuration registers.

properties:
  compatible:
    const: slim217,220

  reg:
    maxItems: 1

  slim-ifc-dev:
    $ref: /schemas/types.yaml#/definitions/phandle
    description: SLIMbus interface device of the chip

  qcom,rx-channels:
    $ref: /schemas/types.yaml#/definitions/uint32-array
    minItems: 1
    maxItems: 2
    description:
      SLIMbus data channels toward the chip, the first one carrying SCO
      downlink and offloaded A2DP

  qcom,tx-channels:
    $ref: /schemas/types.yaml#/definitions/uint32-array
    minItems: 1
    maxItems: 3
    description:
      SLIMbus data channels from the chip, the first one carrying SCO uplink

  "#sound-dai-cells":
    const: 1

required:
  - compatible
  - reg

allOf:
  - $ref: dai-common.yaml#
  - if:
      required:
        - slim-ifc-dev
    then:
      required:
        - qcom,rx-channels
        - qcom,tx-channels
        - "#sound-dai-cells"
    else:
      properties:
        qcom,rx-channels: false
        qcom,tx-channels: false
        "#sound-dai-cells": false

unevaluatedProperties: false

examples:
  - |
    slim {
        #address-cells = <2>;
        #size-cells = <0>;

        bt_ifd: ifd@0,0 {
            compatible = "slim217,220";
            reg = <0 0>;
        };

        bt@1,0 {
            compatible = "slim217,220";
            reg = <1 0>;
            slim-ifc-dev = <&bt_ifd>;
            qcom,rx-channels = <157>;
            qcom,tx-channels = <159>;
            #sound-dai-cells = <1>;
        };
    };
```
