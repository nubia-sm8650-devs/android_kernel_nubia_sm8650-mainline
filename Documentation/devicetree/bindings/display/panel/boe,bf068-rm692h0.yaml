## Documentation/devicetree/bindings/display/panel/boe,bf068-rm692h0.yaml
```yaml
# SPDX-License-Identifier: GPL-2.0-only OR BSD-2-Clause
%YAML 1.2
---
$id: http://devicetree.org/schemas/display/panel/boe,bf068-rm692h0.yaml#
$schema: http://devicetree.org/meta-schemas/core.yaml#

title: BOE BF068 RM692H0 AMOLED DSI panel

maintainers:
  - Cosmin Tanislav <demonsingur@gmail.com>

description:
  The BOE BF068 is a 6.8 inch 1116x2480 AMOLED panel driven by a Raydium
  RM692H0 controller. It runs in DSC compressed command mode over a four
  lane MIPI DSI link.

allOf:
  - $ref: panel-common.yaml#

properties:
  compatible:
    const: boe,bf068-rm692h0

  reg:
    maxItems: 1

  vddio-supply:
    description: 1.8V I/O supply

  vddd-supply:
    description: 1.2V digital supply

  vdd-supply:
    description: 1.2V supply

  vci-supply:
    description: 3.0V analog supply

required:
  - compatible
  - reg
  - reset-gpios
  - vddio-supply
  - vddd-supply
  - vdd-supply
  - vci-supply
  - port

unevaluatedProperties: false

examples:
  - |
    #include <dt-bindings/gpio/gpio.h>

    dsi {
        #address-cells = <1>;
        #size-cells = <0>;

        panel@0 {
            compatible = "boe,bf068-rm692h0";
            reg = <0>;

            reset-gpios = <&tlmm 133 GPIO_ACTIVE_LOW>;

            vddio-supply = <&panel_vddio>;
            vddd-supply = <&panel_vddd>;
            vdd-supply = <&vreg_l11b_1p2>;
            vci-supply = <&vreg_l13b_3p0>;

            port {
                endpoint {
                    remote-endpoint = <&mdss_dsi0_out>;
                };
            };
        };
    };

...
```

## Documentation/devicetree/bindings/interconnect/qcom,camnoc.yaml
```yaml
# SPDX-License-Identifier: (GPL-2.0-only OR BSD-2-Clause)
%YAML 1.2
---
$id: http://devicetree.org/schemas/interconnect/qcom,camnoc.yaml#
$schema: http://devicetree.org/meta-schemas/core.yaml#

title: Qualcomm Camera NOC (CAMNOC) Interconnect Provider

maintainers:
  - Atanas Filipov <atanas.filipov@oss.qualcomm.com>

description:
  The Camera Network-on-Chip (CAMNOC) is the internal AXI interconnect
  within the Qualcomm camera subsystem. It arbitrates AXI bandwidth
  between camera sub-devices (IFE, JPEG, BPS, IPE, etc.) and the external
  memory interconnect. Multiple consumers may independently request
  bandwidth via icc_set_bw(); the CAMNOC ICC provider aggregates all active
  votes and scales CAM_CC_CAMNOC_AXI_CLK accordingly, avoiding the
  last-writer-wins race that arises when each consumer calls clk_set_rate()
  directly on the shared clock.

  Each camera sub-device driver that shares the CAMNOC AXI clock should
  obtain an ICC path from its master port to SLAVE_CAMNOC_AXI and vote for
  bandwidth using the port IDs defined in
  include/dt-bindings/interconnect/qcom,camnoc.h.

properties:
  compatible:
    enum:
      - qcom,sm8250-cam-virt

  clocks:
    items:
      - description: CAMNOC AXI clock

  clock-names:
    items:
      - const: camnoc_axi

  '#interconnect-cells':
    const: 1

required:
  - compatible
  - clocks
  - clock-names
  - '#interconnect-cells'

additionalProperties: false

examples:
  - |
    #include <dt-bindings/clock/qcom,camcc-sm8250.h>
    #include <dt-bindings/interconnect/qcom,camnoc.h>

    /* CAMNOC ICC provider node */
    cam_virt: interconnect-cam-virt {
        compatible = "qcom,sm8250-cam-virt";
        clocks = <&camcc CAM_CC_CAMNOC_AXI_CLK>;
        clock-names = "camnoc_axi";
        #interconnect-cells = <1>;
    };

    /*
     * Simple consumer example: IFE sub-device voting for CAMNOC bandwidth
     * directly via icc_set_bw().
     */
    camera-ife@0 {
        reg = <0x0 0x1000>;

        interconnects = <&cam_virt MASTER_CAMNOC_IFE_0
                         &cam_virt SLAVE_CAMNOC_AXI>;
        interconnect-names = "camnoc";
    };

    /*
     * OPP-based consumer example: JPEG encoder driving its CAMNOC bandwidth
     * vote from the same OPP entry that selects its core clock rate and
     * RPMh performance state. opp-peak-kBps is the minimum CAMNOC bandwidth
     * required at each operating point; the actual value depends on the
     * target resolution and quality settings.
     *
     * opp-hz refers to the JPEG dedicated core clock rate. All shared
     * clocks (e.g. CAMNOC AXI) are managed by the ICC framework so that
     * votes from multiple consumers are aggregated before the rate is
     * applied to the hardware.
     */
    camera-jpeg@ac53000 {
        reg = <0x0ac53000 0x1000>;

        interconnects = <&cam_virt MASTER_CAMNOC_JPEG
                         &cam_virt SLAVE_CAMNOC_AXI>;
        interconnect-names = "camnoc";

        operating-points-v2 = <&jpeg_opp_table>;

        jpeg_opp_table: opp-table {
            compatible = "operating-points-v2";

            opp-100000000 {
                opp-hz = /bits/ 64 <100000000>;
                opp-peak-kBps = <22246>;
                required-opps = <&rpmhpd_opp_min_svs>;
            };

            opp-200000000 {
                opp-hz = /bits/ 64 <200000000>;
                opp-peak-kBps = <44492>;
                required-opps = <&rpmhpd_opp_low_svs>;
            };

            opp-400000000 {
                opp-hz = /bits/ 64 <400000000>;
                opp-peak-kBps = <88983>;
                required-opps = <&rpmhpd_opp_svs>;
            };

            opp-480000000 {
                opp-hz = /bits/ 64 <480000000>;
                opp-peak-kBps = <106780>;
                required-opps = <&rpmhpd_opp_svs_l1>;
            };
        };
    };
```

## Documentation/devicetree/bindings/media/qcom,sm8650-camss-icp.yaml
```yaml
# SPDX-License-Identifier: (GPL-2.0-only OR BSD-2-Clause)
%YAML 1.2
---
$id: http://devicetree.org/schemas/media/qcom,sm8650-camss-icp.yaml#
$schema: http://devicetree.org/meta-schemas/core.yaml#

title: Qualcomm SM8650 CAMSS Image Control Processor

maintainers:
  - Cosmin Tanislav <demonsingur@gmail.com>

description:
  The Image Control Processor (ICP) is a microcontroller inside the camera
  subsystem. It runs the camera firmware, which drives the Image Processing
  Engine (IPE) and the Bayer Processing Segment (BPS).

properties:
  compatible:
    const: qcom,sm8650-camss-icp

  reg:
    maxItems: 2

  reg-names:
    items:
      - const: csr
      - const: wd

  interrupts:
    maxItems: 1

  clocks:
    items:
      - description: ICP AHB clock
      - description: ICP core clock
      - description: QDSS debug XO clock

  clock-names:
    items:
      - const: ahb
      - const: core
      - const: debug_xo

  power-domains:
    maxItems: 1

  iommus:
    maxItems: 5

  dma-coherent: true

  memory-region:
    maxItems: 1
    description: Region the firmware is loaded into.

  firmware-name:
    maxItems: 1

required:
  - compatible
  - reg
  - reg-names
  - interrupts
  - clocks
  - clock-names
  - power-domains
  - iommus
  - memory-region

additionalProperties: false

examples:
  - |
    #include <dt-bindings/clock/qcom,sm8650-camcc.h>
    #include <dt-bindings/interrupt-controller/arm-gic.h>

    icp@ac01000 {
        compatible = "qcom,sm8650-camss-icp";
        reg = <0x0ac01000 0x1000>,
              <0x0ac04000 0x1000>;
        reg-names = "csr",
                    "wd";

        interrupts = <GIC_SPI 463 IRQ_TYPE_EDGE_RISING>;

        clocks = <&camcc CAM_CC_ICP_AHB_CLK>,
                 <&camcc CAM_CC_ICP_CLK>,
                 <&camcc CAM_CC_QDSS_DEBUG_XO_CLK>;
        clock-names = "ahb",
                      "core",
                      "debug_xo";

        power-domains = <&camcc CAM_CC_TITAN_TOP_GDSC>;

        iommus = <&apps_smmu 0x1820 0x0>,
                 <&apps_smmu 0x18c0 0x0>,
                 <&apps_smmu 0x1800 0x0>,
                 <&apps_smmu 0x1840 0x0>,
                 <&apps_smmu 0x1880 0x0>;
        dma-coherent;

        memory-region = <&camera_mem>;
        firmware-name = "qcom/sm8650/CAMERA_ICP.mbn";
    };
...
```

## Documentation/devicetree/bindings/net/nfc/st,st54l-ese.yaml
```yaml
# SPDX-License-Identifier: (GPL-2.0-only OR BSD-2-Clause)
%YAML 1.2
---
$id: http://devicetree.org/schemas/net/nfc/st,st54l-ese.yaml#
$schema: http://devicetree.org/meta-schemas/core.yaml#

title: STMicroelectronics ST54L embedded secure element

maintainers:
  - Cosmin Tanislav <demonsingur@gmail.com>

description:
  The ST54L pairs an NFC controller with an embedded secure element. The
  secure element has its own SPI interface, over which the host exchanges
  ISO/IEC 7816-3 T=1 blocks with it from userspace. Its power request input
  belongs to the NFC controller, see st,st-nci.yaml.

allOf:
  - $ref: /schemas/spi/spi-peripheral-props.yaml#

properties:
  compatible:
    const: st,st54l-ese

  reg:
    maxItems: 1

required:
  - compatible
  - reg

unevaluatedProperties: false

examples:
  - |
    spi {
        #address-cells = <1>;
        #size-cells = <0>;

        ese@0 {
            compatible = "st,st54l-ese";
            reg = <0>;

            spi-max-frequency = <1000000>;
            spi-cs-setup-delay-ns = <20000>;
        };
    };
```

## Documentation/devicetree/bindings/phy/qcom,sc7280-csi2-phy.yaml
```yaml
# SPDX-License-Identifier: (GPL-2.0 OR BSD-2-Clause)
# Copyright (c) 2026 Qualcomm Innovation Center, Inc. All rights reserved.
%YAML 1.2
---
$id: http://devicetree.org/schemas/phy/qcom,sc7280-csi2-phy.yaml#
$schema: http://devicetree.org/meta-schemas/core.yaml#

title: Qualcomm SC7280 CSI2 PHY

maintainers:
  - Anusha Arun Nandi <anusha.nandi@oss.qualcomm.com>

description:
  Qualcomm MIPI CSI2 D-PHY. Connects MIPI CSI2 sensors to Qualcomm's Camera
  CSI Decoder on the SC7280.

properties:
  compatible:
    const: qcom,sc7280-csi2-phy

  reg:
    maxItems: 1

  clocks:
    maxItems: 2

  clock-names:
    items:
      - const: core
      - const: timer

  interrupts:
    maxItems: 1

  operating-points-v2: true

  opp-table:
    type: object

  power-domains:
    items:
      - description: Titan Top GDSC - Titan ISP Block, Global Distributed Switch Controller.

  power-domain-names:
    items:
      - const: top

  vdda-phy-supply:
    description: Phandle to PHY supply.

  vdda-pll-supply:
    description: Phandle to PLL supply.

  ports:
    $ref: /schemas/graph.yaml#/properties/ports

    properties:
      port@0:
        $ref: /schemas/graph.yaml#/$defs/port-base
        description:
          Sensor input. A single sensor is described by a single endpoint
          with one to four data lanes, numbered 1-4. The clock lane is
          position 0.

        unevaluatedProperties: false

        patternProperties:
          "^endpoint(@0)?$":
            $ref: /schemas/media/video-interfaces.yaml#
            unevaluatedProperties: false
            properties:
              bus-type:
                enum:
                  - 1 # MEDIA_BUS_TYPE_CSI2_CPHY
                  - 4 # MEDIA_BUS_TYPE_CSI2_DPHY
                default: 4

              data-lanes:
                minItems: 1
                maxItems: 4
                items:
                  minimum: 1
                  maximum: 4
                description:
                  Data lane positions following this endpoint's clock
                  lane. Positions are a per-port logical numbering, not
                  package pad or ball positions.

            required:
              - data-lanes
              - remote-endpoint

      port@1:
        $ref: /schemas/graph.yaml#/properties/port
        description: Output to the CAMSS CSID controller.

    required:
      - port@0
      - port@1

required:
  - compatible
  - reg
  - clocks
  - clock-names
  - interrupts
  - operating-points-v2
  - power-domains
  - power-domain-names
  - vdda-phy-supply
  - vdda-pll-supply
  - ports

additionalProperties: false

examples:
  - |
    #include <dt-bindings/clock/qcom,camcc-sc7280.h>
    #include <dt-bindings/interrupt-controller/arm-gic.h>
    #include <dt-bindings/media/video-interfaces.h>

    csiphy0: csiphy@ac9c000 {
        compatible = "qcom,sc7280-csi2-phy";
        reg = <0x0ac9c000 0x2000>;

        clocks = <&camcc CAM_CC_CSIPHY0_CLK>,
                 <&camcc CAM_CC_CSI0PHYTIMER_CLK>;
        clock-names = "core",
                      "timer";

        interrupts = <GIC_SPI 477 IRQ_TYPE_EDGE_RISING>;

        operating-points-v2 = <&csiphy0_opp_table>;

        power-domains = <&camcc CAM_CC_TITAN_TOP_GDSC>;
        power-domain-names = "top";

        vdda-phy-supply = <&vreg_l4a>;
        vdda-pll-supply = <&vreg_l1c>;

        ports {
            #address-cells = <1>;
            #size-cells = <0>;

            port@0 {
                reg = <0>;
                csiphy0_in: endpoint {
                    bus-type = <MEDIA_BUS_TYPE_CSI2_DPHY>;
                    data-lanes = <1 2 3 4>;
                    remote-endpoint = <&sensor_out>;
                };
            };

            port@1 {
                reg = <1>;
                csiphy0_out: endpoint {
                    remote-endpoint = <&csid_in>;
                };
            };
        };

        csiphy0_opp_table: opp-table {
            compatible = "operating-points-v2";

            opp-300000000 {
                opp-hz = /bits/ 64 <300000000>;
            };
        };
    };
```
